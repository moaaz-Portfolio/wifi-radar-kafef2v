## tx_node/main/Kconfig.projbuild
```kconfig
menu "WiFi Radar TX configuration"

config RADAR_AP_CHANNEL
    int "SoftAP channel (2.4 GHz)"
    range 1 13
    default 1
    help
        Channel used by the dedicated TX SoftAP. Use a matching channel
        plan on the Analyzer if a future build pins the station scan channel.
        Common non-overlapping choices are 1, 6 and 11.

endmenu
```

## tx_node/sdkconfig.defaults
```kconfig
CONFIG_IDF_TARGET="esp32s3"
CONFIG_ESPTOOLPY_FLASHMODE_DIO=y
CONFIG_ESPTOOLPY_FLASHSIZE_4MB=y
CONFIG_ESPTOOLPY_FLASHFREQ_40M=y
CONFIG_PARTITION_TABLE_CUSTOM=y
CONFIG_PARTITION_TABLE_CUSTOM_FILENAME="partitions.csv"
CONFIG_PARTITION_TABLE_FILENAME="partitions.csv"
CONFIG_PARTITION_TABLE_OFFSET=0xa000
CONFIG_ESP_TASK_WDT_TIMEOUT_S=30
CONFIG_ESP_MAIN_TASK_STACK_SIZE=6144
CONFIG_LWIP_MAX_SOCKETS=16
CONFIG_RADAR_AP_CHANNEL=1
```
